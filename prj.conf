## CMakeLists.txt
```
# SPDX-FileCopyrightText: © 2025-2026 Tenstorrent USA, Inc.
# SPDX-License-Identifier: Apache-2.0

list(APPEND BOARD_ROOT ${CMAKE_CURRENT_SOURCE_DIR})

cmake_minimum_required(VERSION 3.20.0)
find_package(Zephyr REQUIRED HINTS $ENV{ZEPHYR_BASE})
project(wallabmc)

# Boards that use their SoC's native bootloader and skip mcuboot/sysbuild.
set(NO_SYSBUILD_BOARDS "qemu_cortex_m3" "xiao_esp32c6")
if(BOARD IN_LIST NO_SYSBUILD_BOARDS)
	if(SYSBUILD)
		message(FATAL_ERROR "${BOARD} must NOT be built with sysbuild (e.g., no --sysbuild argument)")
	endif()
else()
	if(NOT SYSBUILD)
		message(FATAL_ERROR "Hardware boards must be built with sysbuild (e.g., --sysbuild argument)")
	endif()
endif()


zephyr_linker_sources(SECTIONS sections-rom.ld)
zephyr_linker_sources_ifdef(CONFIG_MBEDTLS_HEAP_CUSTOM_SECTION
  SECTIONS sections-dtcm.ld
)
zephyr_linker_section_ifdef(CONFIG_HTTP_SERVER
  NAME http_resource_desc_web_https_service
  KVMA RAM_REGION GROUP RODATA_REGION
)
zephyr_linker_section_ifdef(CONFIG_HTTP_SERVER
  NAME http_resource_desc_web_http_service
  KVMA RAM_REGION GROUP RODATA_REGION
)

# Used for webserver resources
set(gen_dir ${ZEPHYR_BINARY_DIR}/include/generated/)

# Generate git SHA header at build time so it stays current across commits
find_program(BASH_EXECUTABLE bash)
set(git_sha_header ${gen_dir}/git_sha.h)
add_custom_target(app_git_sha ALL
	COMMAND ${CMAKE_COMMAND}
		-DBASH_EXECUTABLE=${BASH_EXECUTABLE}
		-DSOURCE_DIR=${CMAKE_CURRENT_SOURCE_DIR}
		-DOUTPUT_FILE=${git_sha_header}
		-P ${CMAKE_CURRENT_SOURCE_DIR}/cmake/gen_git_sha.cmake
	BYPRODUCTS ${git_sha_header}
	COMMENT "Generating git SHA header"
)
add_dependencies(app app_git_sha)

target_sources(app PRIVATE
	src/config.c
	src/dhcp.c
	src/main.c
	src/net.c
	src/power.c
	src/synch.c
	src/vpd.c
	src/time.c
)

target_sources_ifdef(CONFIG_RTC app PRIVATE
	src/rtc.c
)

target_sources_ifdef(CONFIG_APP_SENSORS app PRIVATE
	src/sensors.c
)

target_sources_ifdef(CONFIG_APP_BLOCKING_WORKQUEUE app PRIVATE
	src/workq.c
)

target_sources_ifdef(CONFIG_APP_NTP app PRIVATE
	src/ntp.c
)

target_sources_ifdef(CONFIG_APP_WIFI app PRIVATE
	src/wifi.c
)

target_sources_ifdef(CONFIG_HTTP_SERVER app PRIVATE
	src/http.c
)

target_sources_ifdef(CONFIG_APP_HTTPS_PUBLIC_KEY app PRIVATE
	src/https_cert.c
)

target_sources_ifdef(CONFIG_MBEDTLS app PRIVATE
	src/crypto_threading.c
)

target_sources_ifdef(CONFIG_APP_WEB app PRIVATE
	src/web.c
)

target_sources_ifdef(CONFIG_JTAG app PRIVATE
	src/jtag.c
)

target_sources_ifdef(CONFIG_APP_CONSOLE_LOGGER app PRIVATE
	src/console_logger.c
)

target_sources_ifdef(CONFIG_CONSOLE_BRIDGE app PRIVATE
	src/console_bridge.c
)

target_sources_ifdef(CONFIG_APP_WEB_TERMINAL_HOST_SERIAL app PRIVATE
	src/console_bridge_ws.c
)

target_sources_ifdef(CONFIG_PERSISTENT_STORAGE app PRIVATE
	src/button.c
	src/fs.c
)

target_sources_ifdef(CONFIG_REDFISH app PRIVATE
	src/redfish.c
)

if(CONFIG_REDFISH)
  foreach(redfish_resource
    redfish_metadata.xml
  )
    generate_inc_file_for_target(app
      static_web_resources/${redfish_resource}
      ${gen_dir}/${redfish_resource}.gz.inc
      --gzip
    )
  endforeach()
endif()

if(CONFIG_APP_WEB)
  foreach(web_resource
    index.html
  )
    generate_inc_file_for_target(app
      static_web_resources/${web_resource}
      ${gen_dir}/${web_resource}.gz.inc
      --gzip
    )
  endforeach()

  foreach(web_resource
    logo.png
    favicon.png
  )
    generate_inc_file_for_target(app
      static_web_resources/${web_resource}
      ${gen_dir}/${web_resource}.inc
    )
  endforeach()
endif()

if(CONFIG_TF_PSA_CRYPTO_USER_CONFIG)
  # The Mbed TLS libraries link zephyr_interface, so this puts
  # CONFIG_TF_PSA_CRYPTO_USER_CONFIG_FILE and threading_alt.h on their
  # include path
  zephyr_include_directories(src/crypto)
endif()

if(CONFIG_PERSISTENT_STORAGE)
  if(CONFIG_CODE_DATA_RELOCATION_SRAM AND CONFIG_SOC_FLASH_STM32)
    include(${ZEPHYR_BASE}/cmake/modules/extensions.cmake)
    FILE(GLOB flash_driver ${ZEPHYR_BASE}/drivers/flash/flash_stm32*.c)
    zephyr_code_relocate(FILES ${flash_driver} LOCATION RAM)
  elseif(CONFIG_SOC_FLASH_ESP32)
    # ESP32 flash driver disables the XIP cache internally; no relocation needed.
  else()
    message(FATAL_ERROR "flash storage handling is not defined for this platform")
  endif()
endif()
```

## Kconfig
```
# SPDX-FileCopyrightText: © 2025-2026 Tenstorrent USA, Inc.
# SPDX-License-Identifier: Apache-2.0

mainmenu "WallaBMC"

# This UUID should not be changed, it is a namespace from which
# to generate other UUIDs for WallaBMC.
config WALLABMC_UUID_NS
	string
	default "6ae4c3c7-fff0-472a-a77c-6f3f5a09ee7c"

config APP_DNS_RESOLVE
	bool
	select REQUIRES_FULL_LIBC
	select NET_SOCKETS_SERVICE
	select DNS_RESOLVER
	select NET_DHCPV4_OPTION_DNS_ADDRESS
	# If DHCP is not enabled, then need these. For now, DNS/NTP
	# requires DHCP. Could make DNS configurable.
	select DNS_SERVER_IP_ADDRESSES
	select DNS_RECONFIGURE_CLEANUP

config DNS_SERVER1
	string
	default "1.1.1.1" if APP_DNS_RESOLVE

config APP_BLOCKING_WORKQUEUE
	bool
	help
	  Workqueue for blocking, low priority work (see src/workq.h). Work
	  that may block for a long time, such as DNS lookups and network
	  requests, runs here rather than on the system workqueue. Selected
	  by its users.

if APP_BLOCKING_WORKQUEUE

config APP_BLOCKING_WORKQUEUE_STACK_SIZE
	int "Blocking workqueue stack size"
	default 2560 if WIFI
	default 2048
	help
	  Without a TX traffic-class thread (NET_TC_TX_COUNT=0) the whole
	  transmit path down into the Ethernet or Wi-Fi driver runs on this
	  stack, so size it for the deepest network send a work item makes.
	  The NTP sync's DNS lookup on STM32 Ethernet measures about 1.2 KB
	  at -Os and 1.4 KB at -O2 (-fstack-usage). The ESP32 Wi-Fi driver
	  sends through a closed blob below what -fstack-usage can see (the
	  Zephyr side alone is 1.6 to 1.8 KB) and the XIAO build has no
	  stack guard, so Wi-Fi builds get 2560 B.

endif

config APP_NTP
	bool "NTP time synchronisation"
	select SNTP
	select APP_DNS_RESOLVE
	select APP_BLOCKING_WORKQUEUE
	# Could these options reduce our code?
	#CONFIG_NET_CONFIG_CLOCK_SNTP_INIT=y
	#CONFIG_NET_CONFIG_CLOCK_SNTP_SET_RTC=y
	default y

config MAIN_STACK_SIZE
	int
	default 4096 if PERSISTENT_STORAGE

config APP_CRYPTO
	bool
	select NET_SOCKETS_SOCKOPT_TLS
	select MBEDTLS
	select MBEDTLS_ENABLE_HEAP
	select MBEDTLS_SSL_PROTO_TLS1_2
	select MBEDTLS_SSL_ALPN
	# Curve-specific P-256 reduction, much faster TLS handshakes.
	select MBEDTLS_ECP_NIST_OPTIM if PSA_WANT_KEY_TYPE_ECC_KEY_PAIR_BASIC
	# XXX: Should HAVE_TIME_DATE be enabled? Test if it prevents HTTPS
	# connections if the RTC is wrong, in which case it might not be
	# feasible if we need webui to set time.
	# select MBEDTLS_HAVE_TIME_DATE if RTC

config APP_CRYPTO_TLS13
	bool
	default y
	depends on APP_CRYPTO && !APP_CRYPTO_PSK
	select MBEDTLS_SSL_PROTO_TLS1_3
	select MBEDTLS_SSL_TLS1_3_KEY_EXCHANGE_MODE_EPHEMERAL_ENABLED
	select PSA_WANT_ALG_HKDF

config APP_CRYPTO_PUBLIC_KEY
	bool
	# Basic ciphers
	select MBEDTLS_CIPHERSUITE_TLS_ECDHE_ECDSA_WITH_AES_128_GCM_SHA256
	select PSA_WANT_ALG_SHA_256
	# X25519 key exchange alongside P-256 (the certificate stays P-256).
	# Clients such as OpenSSL send only an X25519 key share by default,
	# so without it every TLS 1.3 handshake needs a HelloRetryRequest.
	select PSA_WANT_ECC_MONTGOMERY_255
	# Plus SHA384
	select PSA_WANT_ALG_SHA_384
	# Plus CHACHA20
	select PSA_WANT_ALG_CHACHA20_POLY1305
	select PSA_WANT_KEY_TYPE_CHACHA20

# TF-PSA-Crypto options that Zephyr has no Kconfig for: mbedTLS thread
# safety (see src/crypto_threading.c), needed whenever mbedTLS is used,
# and the optimised routine for X25519 shared secrets, which Zephyr 4.5
# builds and links but has no option to turn on. The header is in
# src/crypto, added to the include path in CMakeLists.txt.
config TF_PSA_CRYPTO_USER_CONFIG_FILE
	default "tf-psa-crypto-user-config.h" if MBEDTLS

# PSK can only use TLS1.2 (supporting 1.3 seems to require pulling in
# so much that it is not worthwhile).
config APP_CRYPTO_PSK
	bool
	select MBEDTLS_KEY_EXCHANGE_PSK_ENABLED # TLS1.2
	select MBEDTLS_CIPHERSUITE_TLS_PSK_WITH_AES_128_GCM_SHA256

config APP_CRYPTO_DEBUG
	bool "crypto debug"
	default n
	select MBEDTLS_DEBUG
	select MBEDTLS_MEMORY_DEBUG

config MBEDTLS_DEBUG_LEVEL
	int
	depends on APP_CRYPTO_DEBUG
	default 1

# Every HTTPS connection parses its own copy of an installed certificate
# chain. With 3 connections at once, the most the HTTPS service accepts
# (src/http.c), the heap peaks at about 45 KiB with the largest chain that
# can be installed, against 34 KiB with a self-signed certificate. The
# allocator's 32 B header on each block is not in those figures and adds
# about 3.5 KiB. Installing a certificate, issuing one and making a CSR also
# take temporary buffers from it, see src/https_cert.c.
#
# 52992 B (51.75 KiB) is what is left of a 64 KiB DTCM after the 12544 B of
# STM32 Ethernet DMA buffers, so that the heap can be placed there.
config MBEDTLS_HEAP_SIZE
	int
	depends on APP_CRYPTO
	default 52992 if APP_HTTPS_PUBLIC_KEY
	default 49152

config NET_PKT_RX_COUNT
	int
	depends on APP_CRYPTO
	default 32

config NET_PKT_TX_COUNT
	int
	depends on APP_CRYPTO
	default 32

config NET_BUF_RX_COUNT
	int
	default 96 if APP_CRYPTO
	default 64

config NET_BUF_TX_COUNT
	int
	default 96 if APP_CRYPTO
	default 64

config NET_SOCKETS_TLS_MAX_CONTEXTS
	int
	depends on APP_CRYPTO
	default 6

# The Kconfig comments for this option say TLS standards require
# 16k size, but this requires several 16K allocations each for
# send and recv on the heap so it's too large. Apparently browsers
# negotiate smaller sizes, so 1500 should be okay there. Redfish
# and curl with auth headers seem to require more (4096 works).
# may require more?
config MBEDTLS_SSL_IN_CONTENT_LEN
	int
	depends on APP_CRYPTO
	default 4096

config MBEDTLS_SSL_OUT_CONTENT_LEN
	int
	depends on APP_CRYPTO
	default 4096

config APP_HTTP
	bool "Serve web and redfish over plain HTTP" if APP_HTTPS
	default !APP_HTTPS
	depends on REDFISH || APP_WEB
	help
	  Serve the web UI, Redfish and websocket consoles over plain HTTP
	  on port 80. Credentials (HTTP Basic auth, websocket auth) are sent
	  in the clear over this port.

	  If disabled, port 80 still accepts connections but redirects
	  requests for the web UI and Redfish to the same URL over HTTPS.
	  Websocket consoles aren't available over plain HTTP.

	  Can only be disabled if APP_HTTPS is enabled. Defaults to disabled
	  if APP_HTTPS is enabled, otherwise it's always enabled.

# Room for the captured Authorization, X-Auth-Code and Host headers at
# HTTP_SERVER_MAX_HEADER_LEN.
config HTTP_SERVER_CAPTURE_HEADER_BUFFER_SIZE
	int
	default 192

# Room for the redirect to HTTPS over HTTP/2, with the longest Location.
# Checked by a BUILD_ASSERT in http.c.
config HTTP_SERVER_HTTP2_MAX_HEADER_FRAME_LEN
	int
	default 352 if !APP_HTTP

config APP_HTTPS
	bool "HTTPS support for web and redfish"
	default y
	depends on REDFISH || APP_WEB
	select HTTP_SERVER_TLS_USE_ALPN
	select APP_CRYPTO

config APP_HTTPS_PUBLIC_KEY
	bool "HTTPS public key support"
	default y
	depends on APP_HTTPS
	select APP_CRYPTO_PUBLIC_KEY
	# The key and self-signed certificate are generated on the board
	select MBEDTLS_PK_PARSE_C
	select MBEDTLS_PK_WRITE_C
	select MBEDTLS_X509_CRT_PARSE_C
	select MBEDTLS_X509_CRT_WRITE_C
	# Zephyr only defines MBEDTLS_X509_CREATE_C, which the certificate
	# writer needs, along with the CSR writer. Unused code is discarded
	# at link time.
	select MBEDTLS_X509_CSR_WRITE_C
	# Subject key identifier
	select PSA_WANT_ALG_SHA_1
	# The BMC UUID is in the self-signed certificate's subject, so it must
	# be unique to the board, not the fixed fallback UUID
	select APP_BMC_UUID
	# Installed certificate chains are registered as PEM
	select MBEDTLS_PEM_PARSE_C
	# CAs often have P-384 keys, eg. Let's Encrypt's ECDSA intermediates,
	# so allow them in an installed chain. The BMC's own key is still
	# P-256, which is faster, see docs/https-certificates.md.
	select PSA_WANT_ECC_SECP_R1_384

config APP_HTTPS_PSK
	bool "HTTPS PSK support"
	default n
	depends on APP_HTTPS
	select APP_CRYPTO_PSK

config APP_BMC_UUID
	bool "BMC UUID based on HWINFO device ID"
	select MBEDTLS
	select MBEDTLS_PSA_CRYPTO_C
	select PSA_WANT_ALG_SHA_1
	select UUID
	select UUID_V5
	select HWINFO

config APP_SENSORS
	bool "BMC Sensors (temperature)"
	select SENSOR
	select ADC

config REDFISH
	bool "Redfish server"
	default y
	select HTTP_SERVER
	select HTTP_SERVER_CAPTURE_HEADERS
	select JSON_LIBRARY
	select APP_BMC_UUID
	select BASE64

if REDFISH

config REDFISH_SYSTEM_PRODUCT_NAME
	string "Redfish system product / board display name"
	default "WallaBMC Board"
	help
	  Shown as System Name in Redfish and in the dashboard System Overview.

config REDFISH_SYSTEM_MANUFACTURER
	string "Redfish system manufacturer"
	default "WallaBMC"

config REDFISH_SYSTEM_MODEL
	string "Redfish system model"
	default "Generic"

config REDFISH_SYSTEM_PROCESSOR_MODEL
	string "Redfish processor summary model"
	default "N/A"

config REDFISH_SYSTEM_PROCESSOR_COUNT
	int "Redfish processor summary count"
	default 1

config REDFISH_SYSTEM_MEMORY_GIB
	int "Redfish memory summary total (GiB)"
	default 0
	help
	  Total system memory in GiB for Redfish MemorySummary. 0 shows as N/A.

config HTTP_SERVER_MAX_HEADER_LEN
	int
	default 48 # Basic auth header + 15 character password is 34 characters

endif # REDFISH

config HTTP_SERVER_NUM_SERVICES
	int
	default 2 if APP_HTTPS # default 1 (listen on just 80)

config HTTP_SERVER_MAX_CLIENTS
	int
	default 8 if APP_WEB

# The web UI polls Redfish every 10 s. With the 10 s Zephyr default the
# server drops the idle connection just before each poll, so every poll
# needs a new connection and TLS handshake.
config HTTP_SERVER_CLIENT_INACTIVITY_TIMEOUT
	int
	default 30 if APP_WEB

config APP_WEB
	bool "Web server"
	default y
	select HTTP_SERVER
	select REDFISH

config APP_WEB_TERMINAL
	bool "Websocket consoles and webui terminal emulator"
	default y
	select APP_WEB
	select HTTP_SERVER_WEBSOCKET

config APP_WEB_TERMINAL_BMC_SHELL
	bool "Zephyr shell websocket and webui terminal"
	default y
	depends on APP_WEB_TERMINAL
	select SHELL
	select SHELL_BACKEND_WEBSOCKET
	select LOG_BACKEND_WS
	select LOG_BACKEND_WS_AUTOSTART

config APP_WEB_TERMINAL_HOST_SERIAL
	bool "Host serial websocket and webui terminal"
	default y
	select APP_CONSOLE_LOGGER
	depends on APP_WEB_TERMINAL

if APP_WEB_TERMINAL_HOST_SERIAL
config CONSOLE_BRIDGE_WS_STACK_SIZE
	int
	default 4096 if APP_HTTPS
	default 2048

config CONSOLE_BRIDGE_WS_PRIORITY
	int
	default 5
endif

config SHELL_WEBSOCKET_ENDPOINT_URL
	string
	depends on SHELL_BACKEND_WEBSOCKET
	default "console/bmc"

config DEFAULT_ADMIN_PASSWORD
	string "Default admin password"
	default "$(shell,openssl rand -base64 12 | head -c 15)"

config SYSTEM_WORKQUEUE_STACK_SIZE
	int
	depends on HTTP_SERVER_WEBSOCKET
	default 2560 if APP_HTTPS
	default 1536

# WS log backend uses lot of stack
config LOG_PROCESS_THREAD_STACK_SIZE
	int
	depends on LOG_BACKEND_WS
	default 2560

config NET_TCP_MAX_RECV_WINDOW_SIZE
	int
	default 20480

# Increase retry and timeout limits
config NET_TCP_INIT_RETRANSMISSION_TIMEOUT
	int
	default 500

config NET_TCP_RETRY_COUNT
	int
	default 10

# Reissuing the HTTPS certificate from the shell (eg. "config bmc hostname")
# signs it on the shell thread, which needs about 1.3 KiB more.
config SHELL_STACK_SIZE
	int
	default 3584 if APP_HTTPS_PUBLIC_KEY
	default 3072 if SHELL_BACKEND_WEBSOCKET

config HTTP_SERVER_STACK_SIZE
	int
	depends on LOG_BACKEND_WS
	default 4096

config NET_SOCKETS_SERVICE_STACK_SIZE
	int
	default 3072 if APP_CRYPTO
	default 1536

config NET_MAX_CONTEXTS
	int
	depends on HTTP_SERVER
	default 12

config NET_MAX_CONN
	int
	depends on HTTP_SERVER
	default 16

config ZVFS_EVENTFD_MAX
	int
	depends on HTTP_SERVER
	default 4

config ZVFS_POLL_MAX
	int
	depends on HTTP_SERVER
	default 8

config PERSISTENT_STORAGE
	bool "Persistent storage for config"
	default n
	# Enable Flash and Flash Map to access memory
	select FLASH
	select FLASH_MAP
	# select FLASH_SHELL if SHELL # ~4kB flash
	# STM32 internal flash is also XIP, so the flash driver has to be
	# relocated into RAM to write it. ESP32's flash driver disables
	# the XIP cache internally, so no relocation is needed there.
	select CODE_DATA_RELOCATION_SRAM if SOC_FLASH_STM32
	# XXX: May need to enable these, or disable IRQs in the flash
	# erase and program functions while flash is being written.
	# select SRAM_VECTOR_TABLE
	# select SRAM_SW_ISR_TABLE
	# select DEVICE_MUTABLE
	# Enable NVS key-value system
	select NVS
	select NVS_INIT_BAD_MEMORY_REGION # Do not require erased flash

config REBOOT
	bool
	default y

config POWEROFF
	bool
	default y if HAS_POWEROFF

config APP_HOST_POWER_PULSE
	bool "Host power pin uses momentary-button (pulse) semantics"
	default n
	help
	  When set, `power on` / `power off` send a short press on the
	  host power GPIO instead of holding it at a sustained level,
	  and `power force-off` / Redfish ForceOff hold it for a long
	  press. Use for boards with an ATX-style momentary power
	  button input.

	  A momentary button gives the BMC no feedback. Without a
	  host-power-good input the BMC cannot tell whether the host is
	  on: `power on` / `power off` / Redfish On always press (a
	  short press toggles, so On sent to a running host asks it to
	  shut down), force-off and PowerCycle always hold the long
	  press first, and host auto power-on is ignored at BMC boot
	  because the press could shut down a host that is already
	  running. Redfish then reports PowerState as null (the web UI
	  shows Unknown) and `power state` reports unknown.

	  To fix that, wire the host's power-good (PWROK) output to a
	  GPIO and point the host-power-good devicetree alias at it.
	  The BMC then reports what the input reads, skips an on, off
	  or force-off press when the host already reads that state,
	  refuses a reset when the host reads off, and presses at BMC
	  boot for host auto power-on only when the host reads off.

	  Without this, the GPIO is driven to a sustained level (the
	  legacy nucleo LED-as-power-stand-in behaviour).

config APP_HOST_POWER_PULSE_MS
	int "Short-press duration for power on/off (ms)"
	default 200
	depends on APP_HOST_POWER_PULSE

config APP_HOST_POWER_FORCE_OFF_MS
	int "Long-press duration for power force-off (ms)"
	default 6000
	depends on APP_HOST_POWER_PULSE
	help
	  The thread that asked for the force-off sleeps through the
	  press; for Redfish that is the HTTP server thread. Keep this
	  plus the 2 s PowerCycle gap below
	  HTTP_SERVER_CLIENT_INACTIVITY_TIMEOUT (30 s with APP_WEB,
	  otherwise 10 s) or other HTTP clients are dropped while the
	  button is held.

config APP_WIFI
	bool "Connect to Wi-Fi at boot from BMC config"
	select WIFI
	select NET_L2_WIFI_MGMT
	help
	  Enable Wi-Fi support. Default SSID and password can be set by
	  updating config or passing cmdline build options (see README.md).
	  SSID and password can be changed and persisted in nonvolatile
	  configuration.

config APP_WIFI_DISABLE_POWER_SAVING
	bool "Wi-Fi disable power saving"
	depends on APP_WIFI
	help
	  Disable WIFI Power Saving, can be set by board config.

config DEFAULT_WIFI_SSID
	string "Default WiFi SSID (blank for none)"
	depends on APP_WIFI
	default ""

config DEFAULT_WIFI_PASSWORD
	string "Default WiFi password (blank for none)"
	depends on APP_WIFI
	default ""

config JTAG
	bool "JTAG support"
	depends on $(dt_path_enabled,/jtag)
	default y

if JTAG

config JTAG_DAEMON_STACK_SIZE
	int "JTAG daemon stack size"
	default 1024

config JTAG_DAEMON_PRIORITY
	int "JTAG daemon priority"
	default 5

endif

# use `kernel thread stack` shell command
config APP_STACK_DEBUG
	bool
	default n
	select THREAD_NAME
	select THREAD_ANALYZER
	select THREAD_ANALYZER_RUN_UNLOCKED

config APP_CONSOLE_LOGGER
	bool "Console logger (capture host console uart)"
	default y
	select SERIAL
	select UART_INTERRUPT_DRIVEN

if APP_CONSOLE_LOGGER
config APP_CONSOLE_LOG_SIZE
	int "Console log size"
	range 64 65536
	default 2048
endif

config CONSOLE_BRIDGE
	bool "Console bridge (host console to TCP port 22)"
	default y
	depends on APP_CONSOLE_LOGGER

if CONSOLE_BRIDGE

config CONSOLE_BRIDGE_STACK_SIZE
	int "Console bridge daemon stack size"
	default 1024

config CONSOLE_BRIDGE_PRIORITY
	int "Console bridge daemon priority"
	default 5

endif

# Quieten the Ethernet PHY drivers, phy_mii logs every link change at
# INF. The choice only exists on boards that enable ETH_DRIVER, so
# default it here rather than assign it in prj.conf.
if ETH_PHY_DRIVER

choice PHY_LOG_LEVEL_CHOICE
	default PHY_LOG_LEVEL_WRN
endchoice

endif # ETH_PHY_DRIVER

source "Kconfig.zephyr"
```

## prj.conf
```kconfig
# Respect flash partition layout
CONFIG_USE_DT_CODE_PARTITION=y

# Kernel options
CONFIG_BOOT_BANNER=n # Do our own banner
CONFIG_EARLY_CONSOLE=y

CONFIG_POSIX_API=y
# Implied by POSIX_API; it selects thread runtime stats, which time every
# context switch. Nothing here uses sleep(), getpid() or times().
CONFIG_POSIX_MULTI_PROCESS=n

# Net debug
#CONFIG_NET_SOCKETS_LOG_LEVEL_DBG=y
#CONFIG_SNTP_LOG_LEVEL_DBG=y
#CONFIG_NET_LOG=y

CONFIG_RTC=y

# Logging
CONFIG_LOG=y
#CONFIG_LOG_DEFAULT_LEVEL=0
CONFIG_LOG_PRINTK=n
# CONFIG_NET_LOG=y # ~10kB flash

# Generic networking options
CONFIG_NETWORKING=y
CONFIG_NET_IPV4=y
CONFIG_NET_IPV6=n
CONFIG_NET_ARP=y
# Single interface with one default gateway, no need for a route table
CONFIG_NET_IPV4_ROUTE=n
# The default of 2 is the gateway and one LAN peer. A third peer evicts
# one of them and each then has to be resolved again.
CONFIG_NET_ARP_TABLE_SIZE=8
CONFIG_NET_UDP=y
CONFIG_NET_TCP=y

# IP address options
# 2 addresses so we can have a DHCP and an overridable static */
CONFIG_NET_CONFIG_AUTO_INIT=n
CONFIG_NET_IF_UNICAST_IPV4_ADDR_COUNT=2
CONFIG_NET_DHCPV4=y
CONFIG_NET_DHCPV4_OPTION_CALLBACKS=y
# Send the first DHCP DISCOVER 1 to 2 s after the interface comes up,
# not the RFC 2131 1 to 10 s (2 is the lowest the Kconfig range allows)
CONFIG_NET_DHCPV4_INITIAL_DELAY_MAX=2
# Poll the PHY link state every 100 ms, not 500 ms, so the link is
# seen sooner once autonegotiation has finished
CONFIG_PHY_MONITOR_PERIOD=100
#CONFIG_DNS_RESOLVER=y # This makes telnet console hang?
# Hostname will be registered with DHCP so if the network supports it,
# it will be the DNS name too. UNIQUE=y appends a random UUID to the
# end of HOSTNAME, you will need to watch the console to get this, or
# give yourself a unique hostname.
CONFIG_NET_CONFIG_SETTINGS=y
CONFIG_NET_HOSTNAME_ENABLE=y
CONFIG_NET_HOSTNAME="wallabmc"
# The hostname can be changed at runtime from the BMC config
CONFIG_NET_HOSTNAME_DYNAMIC=y
# Don't want to append a unique string because that makes it hard to
# find.
#CONFIG_NET_HOSTNAME_UNIQUE=y
# default / no-DHCP IP address
#CONFIG_NET_CONFIG_MY_IPV4_ADDR="192.168.2.55"

# `date set` does not set the RTC which would be confusing, so
# disable it. We supply `bmc time` commands.
CONFIG_DATE_SHELL=n
# local/network shell
CONFIG_KERNEL_SHELL=n # ~5kB flash
#CONFIG_SHELL_TAB=y
#CONFIG_NET_SHELL=y # ~40kB flash

# GPIO options
CONFIG_GPIO=y

### Storage ###
CONFIG_PERSISTENT_STORAGE=y

# Websocket default prompt (does not enable anything on it's own)
CONFIG_SHELL_WEBSOCKET_PROMPT="bmc:~$ "
```

## boards/atlantis_evb_mcu.conf
```kconfig
# -Os: the application has to fit two image slots in 1 MB of flash. The
# crypto libraries stay at -O2, see CMakeLists.txt.
CONFIG_SIZE_OPTIMIZATIONS=y

CONFIG_APP_SENSORS=y

# Redfish system overview (board-specific)
CONFIG_REDFISH_SYSTEM_PRODUCT_NAME="Atlantis EVB"
CONFIG_REDFISH_SYSTEM_MANUFACTURER="Tenstorrent"
CONFIG_REDFISH_SYSTEM_MODEL="Atlantis EVB"
CONFIG_REDFISH_SYSTEM_PROCESSOR_MODEL="Tenstorrent Atlantis"

# The STM32F7 have I and D caches
CONFIG_CACHE_MANAGEMENT=y
```

## boards/atlantis_slt_mcu.conf
```kconfig
# -Os: the application has to fit two image slots in 1 MB of flash. The
# crypto libraries stay at -O2, see CMakeLists.txt.
CONFIG_SIZE_OPTIMIZATIONS=y

CONFIG_APP_SENSORS=y

# Redfish system overview (board-specific)
CONFIG_REDFISH_SYSTEM_PRODUCT_NAME="Atlantis SLT"
CONFIG_REDFISH_SYSTEM_MANUFACTURER="Tenstorrent"
CONFIG_REDFISH_SYSTEM_MODEL="Atlantis SLT"
CONFIG_REDFISH_SYSTEM_PROCESSOR_MODEL="Tenstorrent Atlantis"

# The STM32F7 have I and D caches
CONFIG_CACHE_MANAGEMENT=y
```

## boards/nucleo_f767zi_atlantis.conf
```kconfig
# -Os: the application has to fit two image slots in 1 MB of flash. The
# crypto libraries stay at -O2, see CMakeLists.txt.
CONFIG_SIZE_OPTIMIZATIONS=y

CONFIG_APP_SENSORS=y

# The STM32F7 have I and D caches
CONFIG_CACHE_MANAGEMENT=y
```

## dts/bindings/wallabmc,power-rail.yaml
```yaml
# SPDX-FileCopyrightText: © 2026 Tenstorrent USA, Inc.
# SPDX-License-Identifier: Apache-2.0

description: |
  Host power rail driven by the BMC: an enable GPIO and the power-good
  inputs that confirm it. A wallabmc,power-sequencer node lists the
  rails in the order they are brought up; power off is the reverse.

  Example:

    p5v: p5v {
        compatible = "wallabmc,power-rail";
        enable = <&power_5v_en>;
        power-good = <&pwr_good_5v>;
        off-delay-ms = <100>;
    };
    vcore: vcore {
        compatible = "wallabmc,power-rail";
        enable = <&vcore_0v8_en>;
        power-good = <&pg_ph1>;
    };

compatible: "wallabmc,power-rail"

include: base.yaml

properties:
  enable:
    type: phandle
    required: true
    description: |
      Node with a gpios property (for example a gpio-leds child) whose
      GPIO is driven active to bring the rail up and inactive to take it
      down.

  power-good:
    type: phandles
    description: |
      Nodes with a gpios property that must all read inactive before
      the enable is asserted and active afterwards. They are polled
      every millisecond for up to power-good-timeout-ms; on timeout the
      power on fails and the rails are taken down again.

  power-good-timeout-ms:
    type: int
    default: 1000
    max: 65535
    description: |
      Time allowed for the power-good inputs to change level.

  settle-ms:
    type: int
    default: 0
    max: 65535
    description: |
      Delay after the rail is up (power-good inputs active, or the
      enable asserted when there are none) before the next rail or,
      after the last rail, before the host reset is released.

  off-delay-ms:
    type: int
    default: 0
    max: 65535
    description: |
      Delay on power off (and on the back-out after a failed power on),
      which walk the reverse of power-on-sequence, between taking down
      the rails listed after this one and driving this rail's enable
      inactive. For a rail the regulators taken down earlier need while
      they shut down.
```

## src/main.c
```c
/*
 * SPDX-FileCopyrightText: © 2025-2026 Tenstorrent USA, Inc.
 * SPDX-License-Identifier: Apache-2.0
 */

#include <zephyr/logging/log.h>
#include <zephyr/logging/log_ctrl.h>
LOG_MODULE_REGISTER(wallabmc, LOG_LEVEL_INF);

#include <zephyr/kernel.h>
#include <zephyr/drivers/gpio.h>
#include <zephyr/sys/reboot.h>
#include <zephyr/sys/poweroff.h>
#include <zephyr/shell/shell.h>

#include "fs.h"
#include "config.h"
#include "button.h"
#include "net.h"
#include "wifi.h"
#include "http.h"
#include "https_cert.h"
#include "power.h"
#include "rtc.h"
#include "sensors.h"
#include "jtag.h"
#include "console_logger.h"
#include "console_bridge.h"
#include "console_bridge_ws.h"
#include "vpd.h"
#include "workq.h"
#include "git_sha.h"

#define STATUS_LED DT_ALIAS(status_led)

static bool boot_finished = false;

bool is_boot_finished(void)
{
	return boot_finished;
}

static void print_banner(void)
{
	int pad = 20;

	printk("\n");
	printk("%*s    +---------------------+\n", pad, "");
	printk("%*s    | Welcome to WallaBMC |\n", pad, "");
	printk("%*s    +---------------------+\n", pad, "");
	printk("%*s                 \\\n", pad, "");
	printk("%*s                   \\     /)\n", pad, "");
	printk("%*s                      <.' \\_\n", pad, "");
	printk("%*s                        / ( )\\\n", pad, "");
	printk("%*s                        __|/  \\__\n", pad, "");
	printk("%*s.,.,.,,,..,,.,.,.,.,..,,.,.,.,,.,..,,.,.,.,.\n", pad, "");

	LOG_INF("Project build: %s", PROJECT_GIT_SHA);
	LOG_INF("Zephyr OS build: %s", BANNER_VERSION);
	/* Test only: about 1 KB of text, to move the size report */
	LOG_INF("%s",
		"size report test padding line 00 ........................\n"
		"size report test padding line 01 ........................\n"
		"size report test padding line 02 ........................\n"
		"size report test padding line 03 ........................\n"
		"size report test padding line 04 ........................\n"
		"size report test padding line 05 ........................\n"
		"size report test padding line 06 ........................\n"
		"size report test padding line 07 ........................\n"
		"size report test padding line 08 ........................\n"
		"size report test padding line 09 ........................\n"
		"size report test padding line 10 ........................\n"
		"size report test padding line 11 ........................\n"
		"size report test padding line 12 ........................\n"
		"size report test padding line 13 ........................\n"
		"size report test padding line 14 ........................\n"
		"size report test padding line 15 ........................\n"
		"size report test padding line 16 ........................\n"
		"size report test padding line 17 ........................\n"
		"size report test padding line 18 ........................\n"
		"size report test padding line 19 ........................\n");
#if defined(CONFIG_REDFISH)
	LOG_INF("Board: %s", CONFIG_REDFISH_SYSTEM_PRODUCT_NAME);
	LOG_INF("System: %s %s (CPU: %s x%d, Memory: %d GiB)",
		CONFIG_REDFISH_SYSTEM_MANUFACTURER,
		CONFIG_REDFISH_SYSTEM_MODEL,
		CONFIG_REDFISH_SYSTEM_PROCESSOR_MODEL,
		CONFIG_REDFISH_SYSTEM_PROCESSOR_COUNT,
		CONFIG_REDFISH_SYSTEM_MEMORY_GIB);
#endif
}

#if DT_NODE_HAS_STATUS_OKAY(STATUS_LED)
static const struct gpio_dt_spec status_led = GPIO_DT_SPEC_GET(STATUS_LED, gpios);

/* LED blinking thread */
#define LED_BLINK_PERIOD_DOT    250
#define LED_BLINK_PERIOD_DASH   (3 * LED_BLINK_PERIOD_DOT)
#define LED_BLINK_PERIOD_PAUSE  (LED_BLINK_PERIOD_DOT)
#define LED_BLINK_PERIOD_LETTER (3 * LED_BLINK_PERIOD_DOT)
#define LED_BLINK_PERIOD_WORD   (7 * LED_BLINK_PERIOD_DOT)
#define LED_BLINK_PERIOD_PANIC_US 50000

static void led_dash(void)
{
	gpio_pin_set_dt(&status_led, 1);
	k_msleep(LED_BLINK_PERIOD_DASH);
	gpio_pin_set_dt(&status_led, 0);
	k_msleep(LED_BLINK_PERIOD_PAUSE);
}

static void led_dot(void)
{
	gpio_pin_set_dt(&status_led, 1);
	k_msleep(LED_BLINK_PERIOD_DOT);
	gpio_pin_set_dt(&status_led, 0);
	k_msleep(LED_BLINK_PERIOD_PAUSE);
}

static void status_led_okay(void)
{
	// Flash OK in morse code: - - -   - . -
	while (1) {
		// O
		led_dash();
		led_dash();
		led_dash();

		k_msleep(LED_BLINK_PERIOD_LETTER);

		// K
		led_dash();
		led_dot();
		led_dash();

		// Pause
		k_msleep(LED_BLINK_PERIOD_WORD);
	}
}

static void status_led_fail(void)
{
	while (1)
		led_dot();
}

static void status_led_blink(bool fail)
{
	if (!gpio_is_ready_dt(&status_led))
		return;

	if (fail)
		status_led_fail();
	else
		status_led_okay();
}

static void status_led_panic(void)
{
	if (!gpio_is_ready_dt(&status_led))
		return;

	while (1) {
		gpio_pin_toggle_dt(&status_led);
		/* No sleeping in panic handler */
		k_busy_wait(LED_BLINK_PERIOD_PANIC_US);
	}
}

static int status_led_init(void)
{
	int ret;

	/* Initialize status LED */
	if (gpio_is_ready_dt(&status_led)) {
		ret = gpio_pin_configure_dt(&status_led, GPIO_OUTPUT_INACTIVE);
		if (ret < 0) {
			LOG_INF("Could not configure LED1 GPIO\n");
			return -1;
		}
		gpio_pin_set_dt(&status_led, 1);
	} else {
		LOG_INF("LED1 GPIO not ready\n");
		return -1;
	}

	return 0;
}

#else /* DT_NODE_HAS_STATUS_OKAY(STATUS_LED) */
static void status_led_blink(bool fail)
{
}

static void status_led_panic(void)
{
}

static int status_led_init(void)
{
	return 0;
}
#endif /* DT_NODE_HAS_STATUS_OKAY(STATUS_LED) */

void k_sys_fatal_error_handler(unsigned int reason,
			       const struct arch_esf *esf)
{
	ARG_UNUSED(esf);

	LOG_PANIC();
	LOG_ERR("Halting system!");
	(void)irq_lock();
	status_led_panic();
	for (;;)
		;
	CODE_UNREACHABLE;
}

FUNC_NORETURN int bmc_reboot(void)
{
	net_exit();
	fs_exit();

	LOG_WRN("Rebooting BMC");
	/* log_panic() appears to be needed in order to get the logs out. */
	log_panic();
	k_msleep(100);

	/*
	 * It is said that not all platforms support all reboot types.
	 * Not sure the best way to do this, but try a warm reboot first,
	 * then cold.
	 */
	sys_reboot(SYS_REBOOT_WARM);
	sys_reboot(SYS_REBOOT_COLD);
	k_panic();
	for (;;);
}

static FUNC_NORETURN int bmc_poweroff(void)
{
	fs_exit();

	LOG_WRN("Poweroff BMC");
	/* log_panic() appears to be needed in order to get the logs out. */
	log_panic();
	k_msleep(100);

#ifdef CONFIG_POWEROFF
	sys_poweroff();
	k_panic();
#endif
	for (;;);
}

static int cmd_bmc_reboot(const struct shell *sh, size_t argc, char **argv)
{
	ARG_UNUSED(argc);
	ARG_UNUSED(argv);
	bmc_reboot();
	return 0;
}

static int cmd_bmc_poweroff(const struct shell *sh, size_t argc, char **argv)
{
	ARG_UNUSED(argc);
	ARG_UNUSED(argv);
	bmc_poweroff();
	return 0;
}

#ifdef CONFIG_APP_WIFI
static int cmd_wifi_connect(const struct shell *sh, size_t argc, char **argv)
{
	const char *ssid = NULL;
	const char *password = NULL;
	int rc;

	if (argc >= 2)
		ssid = argv[1];
	if (argc >= 3)
		password = argv[2];

	if (!ssid)
		ssid = config_bmc_wifi_ssid();
	if (!password)
		password = config_bmc_wifi_password();

	rc = wifi_connect(ssid, password);
	if (rc) {
		shell_error(sh, "Wi-Fi connect failed (err=%d)", rc);
		return rc;
	}

	shell_info(sh, "Wi-Fi connecting to %s", ssid);

	return 0;
}

static int cmd_wifi_disconnect(const struct shell *sh, size_t argc, char **argv)
{
	ARG_UNUSED(argc);
	ARG_UNUSED(argv);

	wifi_disconnect();

	shell_info(sh, "Wi-Fi disconnect");

	return 0;
}

SHELL_STATIC_SUBCMD_SET_CREATE(sub_bmc_wifi_cmds,
	SHELL_CMD_ARG(connect,	NULL,
		      "Connect to a Wi-Fi network optionally overriding default credentials.\n"
		      "Usage: wifi connect [ssid] [password]",
		      cmd_wifi_connect, 1, 2),
	SHELL_CMD(disconnect,	NULL, "Disconnect from Wi-Fi AP.", cmd_wifi_disconnect),
	SHELL_SUBCMD_SET_END
);
#endif /* CONFIG_APP_WIFI */

#if defined(CONFIG_APP_HTTPS_PUBLIC_KEY)
SHELL_STATIC_SUBCMD_SET_CREATE(sub_bmc_cert_cmds,
	SHELL_CMD(regenerate,	NULL,
		  "Delete the HTTPS key and certificate and reboot to generate new ones.",
		  https_cert_cmd_regenerate),
	SHELL_CMD(self-signed,	NULL,
		  "Replace an installed HTTPS certificate with a self-signed one.",
		  https_cert_cmd_self_signed),
	SHELL_CMD_ARG(names,	NULL,
		  "Show or set extra names for the HTTPS certificate.\n"
		  "Usage: bmc cert names [<DNS name or IPv4 address>... | clear]",
		  https_cert_cmd_names, 1, 8),
	SHELL_SUBCMD_SET_END
);
#endif

SHELL_STATIC_SUBCMD_SET_CREATE(sub_bmc_cmds,
	SHELL_CMD(reboot,	NULL, "Reboot BMC.", cmd_bmc_reboot),
	SHELL_CMD(poweroff,	NULL, "Power off BMC.", cmd_bmc_poweroff),
#if defined(CONFIG_APP_HTTPS_PUBLIC_KEY)
	SHELL_CMD(cert,		&sub_bmc_cert_cmds, "Show the HTTPS certificate.",
		  https_cert_cmd_show),
#endif
#ifdef CONFIG_APP_WIFI
	SHELL_CMD(wifi,		&sub_bmc_wifi_cmds, "Wi-Fi control commands.", NULL),
#endif
	SHELL_SUBCMD_SET_END
);

SHELL_CMD_REGISTER(bmc, &sub_bmc_cmds, "BMC system commands", NULL);

static int cmd_hop(const struct shell *sh, size_t argc, char **argv)
{
	ARG_UNUSED(argc);
	ARG_UNUSED(argv);

	/* Wallaby on ground */
	const char *wallaby_ground[] = {
		"",
		"",
		"",
		"             /)",
		"          <.' \\_",
		"            / ( )\\",
		"            __|/  \\__",
		NULL
	};

	/* Wallaby in air (hopped up) */
	const char *wallaby_air[] = {
		"             /)",
		"          <.' \\_",
		"            / ( )\\",
		"            |/  \\",
		"            /     \\",
		"",
		"",
		NULL
	};

	int pos;  /* Horizontal position */
	int i, j;
	int max_pos = 60;  /* Maximum horizontal position */
	int num_hops = 4;  /* Number of complete hops */
	bool in_air = false;

	shell_print(sh, "\n");

	for (i = 0; i < num_hops; i++) {
		/* Each hop moves the wallaby forward */
		for (pos = max_pos; pos > 0; pos -= 4) {
			/* Clear screen and move cursor to home position */
			shell_print(sh, "\033[2J\033[H");

			/* Alternate between air and ground every few steps */
			if ((pos / 8) % 2 == 0) {
				in_air = false;
			} else {
				in_air = true;
			}

			const char **current_frame = in_air ? wallaby_air : wallaby_ground;

			/* Print the frame with horizontal offset */
			for (j = 0; current_frame[j] != NULL; j++) {
					shell_print(sh, "%*s%s", pos, "", current_frame[j]);
			}
			shell_print(sh, "----------------------------------------------------------------------------------");

			k_msleep(120);  /* Animation speed */
		}
	}

	shell_print(sh, "\n");

	return 0;
}

SHELL_CMD_REGISTER(hop, NULL, "Make the wallaby hop across the screen.", cmd_hop);

int main(void)
{
	/*
	 * If fail_status is set, the host will not be auto-powered on,
	 * and the status LED will blink fast. The system might still be
	 * usable or at least debuggable, so don't fail entirely.
	 *
	 * Expected or tolerable errors can avoid setting fail_status.
	 */
	bool fail_status = false;

	print_banner();

	/* Turn on the status LED early */
	LOG_DBG("LED init");
	if (status_led_init() < 0) {
		LOG_ERR("LED init failed");
		/* Continue */
	}

	LOG_DBG("RTC init");
	if (rtc_init() < 0) {
		LOG_ERR("RTC init failed");
		fail_status = true;
	}

	LOG_DBG("VPD init");
	if (vpd_init() < 0) {
		LOG_ERR("VPD init failed");
		fail_status = true;
	}

	LOG_DBG("Filesystem init");
	if (fs_init() < 0) {
		LOG_ERR("Filesystem init failed, continuing without persistent storage");
	}

	LOG_DBG("Config init");
	if (config_init() < 0) {
		LOG_ERR("Config init failed");
		fail_status = true;
	}

	/*
	 * After the basics are up
	 */

	LOG_DBG("Button init");
	if (button_init() < 0) {
		LOG_ERR("Button init failed");
		/* Continue, buttons are not critical */
	}

	/*
	 * Before anything can schedule onto it: a delayed item is dropped
	 * silently if its queue has still not started when it expires.
	 */
	LOG_DBG("Blocking workqueue init");
	if (blocking_work_q_init() < 0) {
		LOG_ERR("Blocking workqueue init failed");
		return -1;
	}

	LOG_DBG("Network init");
	if (net_init() < 0) {
		LOG_ERR("Network init failed");
		/* Continue -- shell stays up so the user can `wifi connect`, etc. */
	}

	LOG_DBG("Power init");
	if (power_init() < 0) {
		LOG_ERR("Power init failed");
		fail_status = true;
	}

	LOG_DBG("Reset init");
	if (reset_init() < 0) {
		LOG_ERR("Reset init failed");
		fail_status = true;
	}

	LOG_DBG("JTAG init");
	if (jtag_init() < 0) {
		LOG_ERR("JTAG init failed");
		fail_status = true;
	}

	LOG_DBG("Console logger init");
	if (console_logger_init() < 0) {
		LOG_ERR("Console logger init failed");
		fail_status = true;
	}

	/*
	 * Wait until BMC host interfaces such as power, reset, status are
	 * initialised, host UART logger is running, etc., before host
	 * auto-poweron.
	 *
	 * If auto-poweron fails, a message will be logged. Don't
	 * fail BMC boot, because the admin may want to diagnose
	 * and try power cycling etc.
	 *
	 * If something has failed, don't try to auto-poweron.
	 */
	if (fail_status)
		LOG_WRN("Boot failures encountered, not powering on host");
	else
		power_auto_poweron();

	/*
	 * Interfaces to outside world are brought up after auto poweron, so
	 * they won't race with one another. The zephyr console interface is
	 * generally gated by the boot_finished flag so it should not race with
	 * auto poweron either.
	 */
	LOG_DBG("HTTP server init");
	if (app_http_server_init() < 0) {
		LOG_ERR("HTTP server init failed");
		fail_status = true;
	}

	LOG_DBG("Console bridge init");
	if (console_bridge_init() < 0) {
		LOG_ERR("Console bridge init failed");
		fail_status = true;
	}

	LOG_DBG("Console bridge WS init");
	if (console_bridge_ws_init() < 0) {
		LOG_ERR("Console bridge WS init failed");
		fail_status = true;
	}

	boot_finished = true;

	LOG_INF("BMC boot complete");

	status_led_blink(fail_status);

	/* If no LED, this will fall through and exit the main thread */

	return 0;
}
```

## src/console_logger.c
```c
/*
 * SPDX-FileCopyrightText: © 2025-2026 Tenstorrent USA, Inc.
 * SPDX-License-Identifier: Apache-2.0
 */

#include <zephyr/kernel.h>

#include <zephyr/logging/log.h>
LOG_MODULE_REGISTER(console_logger, LOG_LEVEL_INF);

#include <zephyr/spinlock.h>
#include <zephyr/drivers/uart.h>
#include <zephyr/drivers/gpio.h>
#include <errno.h>
#include <string.h>

#include "synch.h"
#include "console_logger.h"

#define UART_NODE DT_ALIAS(host_console_uart)
static const struct device *uart_dev = DEVICE_DT_GET(UART_NODE);

BUILD_ASSERT(DT_NODE_EXISTS(UART_NODE), "host-console-uart node missing");

/* UART mux select GPIO from device tree */
#define UARTMUXSEL_NODE DT_ALIAS(host_console_uart_muxsel)
#if DT_NODE_EXISTS(UARTMUXSEL_NODE)
static const struct gpio_dt_spec host_console_uart_muxsel_gpio = GPIO_DT_SPEC_GET(UARTMUXSEL_NODE, gpios);
#endif

struct console_log {
	const struct device *uart;
	bool enabled;
	uint64_t received;
	int size;
	struct k_spinlock rx_lock;

	/* TX is serialized by tx_mutex; tx_done is given by the IRQ when
	 * the pending buffer has been fully pushed to the FIFO.
	 */
	struct k_mutex tx_mutex;
	struct k_sem tx_done;
	const uint8_t *tx_buf;
	size_t tx_len;
	size_t tx_pos;

	uint8_t *log_buffer;
};

static struct console_log host_console_log;

static uint8_t log_buffer[CONFIG_APP_CONSOLE_LOG_SIZE];

/* Delay notifying console readers of new data to coalesce data */
/*
 * TODO: NTP puts long running blocking work on the system workqueue
 * which could block the coalescing delay wakeup and cause the console
 * to hang for long periods. So set this to 0 for now (no delay) until
 * NTP blocking work is moved to another workqueue.
 */
#define RX_DELAY_TIME_MS 0

static void rx_data_work_fn(struct k_work *work)
{
	k_event_post(&events, EVENT_CONSOLE_LOG_DATA);
}

static K_WORK_DELAYABLE_DEFINE(rx_data_work, rx_data_work_fn);

static void uart_isr_cb(const struct device *dev, void *user_data)
{
	struct console_log *log = user_data;

	while (uart_irq_update(dev), uart_irq_is_pending(dev)) {
		if (uart_irq_rx_ready(dev) > 0) {
			/*
			 * uart_fifo_read() must read all data from FIFO after
			 * uart_irq_rx_ready() returns true.
			 */
			for (;;) {
				k_spinlock_key_t key = k_spin_lock(&log->rx_lock);
				size_t off = log->received % log->size;
				size_t size = log->size - off;
				int nr = uart_fifo_read(dev, log->log_buffer + off, size);
				if (nr > 0)
					log->received += (size_t)nr;
				k_spin_unlock(&log->rx_lock, key);
				if (nr < 0 || (size_t)nr < size) /* short/zero reads and -ve errors */
					break;
			}
			if (RX_DELAY_TIME_MS)
				k_work_schedule(&rx_data_work, K_MSEC(RX_DELAY_TIME_MS));
			else
				k_event_post(&events, EVENT_CONSOLE_LOG_DATA);
		}

		if (uart_irq_tx_ready(dev) > 0) {
			if (log->tx_pos < log->tx_len) {
				int nr = uart_fifo_fill(dev, log->tx_buf + log->tx_pos,
							log->tx_len - log->tx_pos);
				if (nr > 0)
					log->tx_pos += nr;
			}
			if (log->tx_pos >= log->tx_len) {
				uart_irq_tx_disable(dev);
				k_sem_give(&log->tx_done);
			}
		}
	}
}

static ssize_t console_log_read(struct console_log *log, uint8_t *buf, size_t size, uint64_t *ppos)
{
	uint64_t pos = *ppos;
	uint64_t start;
	int off, len;
	k_spinlock_key_t key;
	ssize_t ret = 0;
	size_t copied = 0;

	if (!host_console_available())
		return -ENODEV;

	key = k_spin_lock(&log->rx_lock);
	if (pos > log->received) {
		ret = -EINVAL;
		goto out;
	}

	if (log->received < log->size) {
		start = 0;
	} else {
		start = log->received - log->size;
	}

	if (start > pos)
		pos = start; /* lost characters, advance pos */

	while (copied < size) {
		off = pos % log->size;
		len = MIN(log->received - pos, log->size - off);
		len = MIN(len, size - copied);
		if (len == 0)
			break;
		memcpy(buf + copied, log->log_buffer + off, len);
		pos += len;
		copied += len;
	}

out:
	k_spin_unlock(&log->rx_lock, key);

	*ppos = pos;

	return copied ? copied : ret;
}

static ssize_t console_log_write(struct console_log *log, const uint8_t *buf, size_t size)
{
	if (!host_console_available())
		return -ENODEV;

	k_mutex_lock(&log->tx_mutex, K_FOREVER);

	log->tx_buf = buf;
	log->tx_len = size;
	log->tx_pos = 0;
	k_sem_reset(&log->tx_done);

	uart_irq_tx_enable(log->uart);
	k_sem_take(&log->tx_done, K_FOREVER);

	log->tx_buf = NULL;
	log->tx_len = 0;
	log->tx_pos = 0;

	k_mutex_unlock(&log->tx_mutex);
	return size;
}

ssize_t host_console_read(uint8_t *buf, size_t size, uint64_t *ppos)
{
	struct console_log *log = &host_console_log;
	return console_log_read(log, buf, size, ppos);
}

int host_console_seek_end(uint64_t *ppos)
{
	struct console_log *log = &host_console_log;
	k_spinlock_key_t key;

	if (!host_console_available())
		return -ENODEV;

	key = k_spin_lock(&log->rx_lock);
	*ppos = log->received;
	k_spin_unlock(&log->rx_lock, key);

	return 0;
}

ssize_t host_console_write(const uint8_t *buf, size_t size)
{
	struct console_log *log = &host_console_log;

	return console_log_write(log, buf, size);
}

static const struct uart_config uart_cfg = {
	.baudrate = 115200,
	.parity = UART_CFG_PARITY_NONE,
	.stop_bits = UART_CFG_STOP_BITS_1,
	.data_bits = UART_CFG_DATA_BITS_8,
	.flow_ctrl = UART_CFG_FLOW_CTRL_NONE,
};

bool host_console_available(void)
{
	struct console_log *log = &host_console_log;

	return log->enabled;
}

int console_logger_init(void)
{
	struct console_log *log = &host_console_log;
	int ret;

	LOG_INF("Starting host console logger");

	if (!device_is_ready(uart_dev)) {
		LOG_ERR("UART device not ready");
		return -1;
	}

	log->uart = uart_dev;
	log->size = sizeof(log_buffer);
	k_mutex_init(&log->tx_mutex);
	k_sem_init(&log->tx_done, 0, 1);
	log->log_buffer = log_buffer;

#if DT_NODE_EXISTS(UARTMUXSEL_NODE)
	/* Initialize host_console_uart_muxsel GPIO */
	if (!gpio_is_ready_dt(&host_console_uart_muxsel_gpio)) {
		LOG_ERR("host_console_uart_muxsel GPIO device not ready");
		return -1;
	}

	ret = gpio_pin_configure_dt(&host_console_uart_muxsel_gpio, GPIO_OUTPUT_INACTIVE);
	if (ret < 0) {
		LOG_ERR("Failed to configure host_console_uart_muxsel GPIO: %d", ret);
		return ret;
	}

	gpio_pin_set_dt(&host_console_uart_muxsel_gpio, 1);
	LOG_INF("host_console_uart_muxsel GPIO set");
#endif

	ret = uart_configure(uart_dev, &uart_cfg);
	if (ret < 0) {
		LOG_ERR("UART configure failed: %d", ret);
		return -1;
	}

	ret = uart_irq_callback_user_data_set(uart_dev, uart_isr_cb, log);
	if (ret < 0) {
		LOG_ERR("Failed to set UART IRQ callback: %d", ret);
		return ret;
	}

	uart_irq_rx_enable(uart_dev);

	log->enabled = true;

	LOG_INF("UART IRQ configured for console logger");

	return 0;
}
```

## src/time.c
```c
/*
 * SPDX-FileCopyrightText: © 2025-2026 Tenstorrent USA, Inc.
 * SPDX-License-Identifier: Apache-2.0
 */

#include <zephyr/logging/log.h>
#include <zephyr/logging/log_ctrl.h>
LOG_MODULE_REGISTER(wallabmc_time, LOG_LEVEL_INF);

#include <stdlib.h>
#include <zephyr/kernel.h>
#include <zephyr/sys/timeutil.h>

#include "time.h"
#include "rtc.h"

static int time_iso_to_ts(const char *str, struct timespec *ts)
{
	/* YYYY-MM-DDTHH:MM:SS.fffZ: the character that ends each field */
	static const char sep[] = "--T::.Z";
	struct tm tm;
	int year, month, day, hour, minute, second, frac, ms;
	int *field[] = { &year, &month, &day, &hour, &minute, &second, &frac };
	time_t epoch_sec;
	const char *p = str;
	char *end;
	int i;

	memset(&tm, 0, sizeof(struct tm));

	for (i = 0; i < ARRAY_SIZE(field); i++) {
		*field[i] = strtol(p, &end, 10);
		if (end == p || *end != sep[i])
			return -EINVAL;
		p = end + 1;
	}
	if (frac < 0 || frac > 999)
		return -EINVAL;
	if (year < 1900)
		return -EINVAL;
	if (month < 1)
		return -EINVAL;

	tm.tm_year = year - 1900;
	tm.tm_mon  = month - 1;
	tm.tm_mday = day;
	tm.tm_hour = hour;
	tm.tm_min  = minute;
	tm.tm_sec  = second;

	epoch_sec = timeutil_timegm(&tm);
	if (epoch_sec == -1)
		return -EINVAL;

	if (frac < 10)
		ms = frac * 100;
	else if (frac < 100)
		ms = frac * 10;
	else
		ms = frac;

	ts->tv_sec = epoch_sec;
	ts->tv_nsec = (int64_t)ms * NSEC_PER_MSEC;

	return 0;
}

int time_set_from_iso_str(const char *str)
{
	static struct timespec ts;
	int ret;

	ret = time_iso_to_ts(str, &ts);
	if (ret != 0) {
		LOG_ERR("time_iso_to_ts failed (err=%d)", ret);
		return ret;
	}

	ret = rtc_set_from_timespec(&ts);
	if (ret != 0) {
		if (ret != -ENODEV)
			LOG_ERR("Updating RTC failed (err=%d)", ret);
		ret = 0; /* Don't fail for any RTC errors */
	}

	ret = sys_clock_settime(SYS_CLOCK_REALTIME, &ts);
	if (ret != 0) {
		LOG_ERR("sys_clock_settime failed (err=%d)", ret);
		return ret;
	}

	return 0;
}
```
